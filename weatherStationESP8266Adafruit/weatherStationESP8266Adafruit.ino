#include <TFT_eSPI.h> // Подключаем библиотеку TFT_eSPI
#include <ESP8266HTTPClient.h>
#include <WiFiClient.h>
#include <Arduino.h>
#include <ESP8266WiFi.h>
#include <JsonListener.h>
#include <time.h>
#include "OpenWeatherMapCurrent.h"
#include <NTPClient.h>
#include <WiFiUdp.h>
#include <UnixTime.h> //библиотека для преобразования времени с unix в utc

//шрифты нового дизайна
#include "Golos_Text_Regular12.h" //маленький текст (2 экран)
#include "Golos_Text_Regular22.h" //текст
#include "Golos_Text_Regular30.h" //мельникие цифры
#include "Golos_Text_Regular44.h" //цифры
#include "Golos_Text_Regular84.h" //большие часы

OpenWeatherMapCurrent client;

TFT_eSPI tft = TFT_eSPI(); // Инициализация дисплея

String OPEN_WEATHER_MAP_APP_ID = "13980c74ae68780b82ce16cbec00fae2";
String OPEN_WEATHER_MAP_LOCATION = "Ekaterinburg";
String OPEN_WEATHER_MAP_LANGUAGE = "en";
boolean IS_METRIC = true;

const char* ESP_HOST_NAME = "esp-" + ESP.getFlashChipId();
const char* WIFI_SSID     = "Ayur"; //"Galaxy A52FADF";
const char* WIFI_PASSWORD = "12082005"; //"izzr8141";

const long utcOffsetInSeconds = 18000;
String daysOfTheWeek[7] = {"вс", "пн", "вт", "ср", "чт", "пт", "сб"};
WiFiUDP ntpUDP;
NTPClient timeClient(ntpUDP, "pool.ntp.org", utcOffsetInSeconds);
uint16_t colors[7]={0xF800, 0xFB20, 0xFFE0, 0x87E0, 0x04E0, 0x07FF, 0x03DF};
uint16_t col=0;
 
String monthsNames[13] = {"Заглушка", "января", "февраля", "марта", "апреля", "мая", "июня", "июля", "августа", "сентября", "октября", "ноября", "декабря"};
String weatherNames[7] = {"облачно", "дождливо", "гроза", "солнечно", "морось", "снежно", "туманно"};
int weatherNum = -1;

String dayName2 = "";
String dayName3 = "";
String dayName4 = "";

int oM = 99;

// 'Туман', 35x35px
const unsigned char mist [175] PROGMEM = {
	0x00, 0x00, 0x00, 0x00, 0x00, 0x00, 0x00, 0x00, 0x00, 0x00, 0x00, 0x00, 0x00, 0x00, 0x00, 0x00, 
	0x00, 0x00, 0x00, 0x00, 0x00, 0x00, 0x00, 0x00, 0x00, 0x00, 0x00, 0x00, 0x00, 0x00, 0x00, 0x00, 
	0x00, 0x00, 0x00, 0x00, 0x00, 0x00, 0x00, 0x00, 0x00, 0x00, 0x00, 0x00, 0x00, 0x00, 0x00, 0x00, 
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	0x00, 0x00, 0x00, 0x00, 0x00, 0x00, 0x00, 0x00, 0x00, 0x00, 0x00, 0x00, 0x00, 0x00, 0x00
};
// 'Морось', 35x35px
const unsigned char drizzle [175] PROGMEM = {
	0x00, 0x00, 0x00, 0x00, 0x00, 0x00, 0x00, 0x00, 0x00, 0x00, 0x00, 0x00, 0x00, 0x00, 0x00, 0x00, 
	0x01, 0xff, 0x80, 0x00, 0x00, 0x07, 0xff, 0xe0, 0x00, 0x00, 0x0f, 0xff, 0xf0, 0x00, 0x00, 0x1f, 
	0xff, 0xf8, 0x00, 0x00, 0x3f, 0xff, 0xfc, 0x00, 0x00, 0x3f, 0xff, 0xfe, 0x00, 0x00, 0x7f, 0xff, 
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	0x00, 0x00, 0x00, 0x00, 0x00, 0x00, 0x00, 0x00, 0x00, 0x00, 0x00, 0x00, 0x00, 0x00, 0x00
};
// 'Солнце', 35x35px
const unsigned char clearS1 [175] PROGMEM = {
	0x00, 0x00, 0x00, 0x00, 0x00, 0x00, 0x00, 0x00, 0x00, 0x00, 0x00, 0x00, 0x00, 0x00, 0x00, 0x00, 
	0x01, 0xc0, 0x00, 0x00, 0x00, 0x01, 0xe0, 0x00, 0x00, 0x00, 0xc1, 0xe1, 0xc0, 0x00, 0x01, 0xe1, 
	0xe3, 0xc0, 0x00, 0x01, 0xf1, 0xe3, 0xc0, 0x00, 0x00, 0xf9, 0xe7, 0x80, 0x00, 0x00, 0x79, 0xc7, 
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	0x00, 0x00, 0x00, 0x00, 0x00, 0x00, 0x00, 0x00, 0x00, 0x00, 0x00, 0x00, 0x00, 0x00, 0x00
};
// 'Снег', 35x35px
const unsigned char snow [175] PROGMEM = {
	0x00, 0x00, 0x00, 0x00, 0x00, 0x00, 0x00, 0x00, 0x00, 0x00, 0x00, 0x00, 0x00, 0x00, 0x00, 0x00, 
	0x07, 0xc1, 0x80, 0x00, 0x00, 0x07, 0xff, 0x80, 0x00, 0x00, 0x1f, 0xdf, 0x80, 0x00, 0x00, 0x1f, 
	0xcf, 0xe0, 0x00, 0x00, 0xef, 0x8f, 0xe0, 0x00, 0x07, 0xe7, 0x8f, 0xd8, 0x00, 0x07, 0xe3, 0x8e, 
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	0x00, 0x00, 0x00, 0x00, 0x00, 0x00, 0x00, 0x00, 0x00, 0x00, 0x00, 0x00, 0x00, 0x00, 0x00
};
// 'Облако', 35x35px
const unsigned char clouds [175] PROGMEM = {
	0x00, 0x00, 0x00, 0x00, 0x00, 0x00, 0x00, 0x00, 0x00, 0x00, 0x00, 0x00, 0x00, 0x00, 0x00, 0x00, 
	0x00, 0x00, 0x00, 0x00, 0x00, 0x00, 0x00, 0x00, 0x00, 0x00, 0x00, 0x00, 0x00, 0x00, 0x00, 0x00, 
	0x00, 0x00, 0x00, 0x00, 0x00, 0xff, 0x80, 0x00, 0x00, 0x03, 0xff, 0xe0, 0x00, 0x00, 0x07, 0xff, 
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	0x00, 0x00, 0x00, 0x00, 0x00, 0x00, 0x00, 0x00, 0x00, 0x00, 0x00, 0x00, 0x00, 0x00, 0x00
};
// 'Дождь', 35x35px
const unsigned char rain [175] PROGMEM = {
	0x00, 0x00, 0x00, 0x00, 0x00, 0x00, 0x00, 0x00, 0x00, 0x00, 0x00, 0x00, 0x00, 0x00, 0x00, 0x00, 
	0x00, 0x00, 0x00, 0x00, 0x00, 0x00, 0xff, 0x00, 0x00, 0x00, 0x03, 0xff, 0xc0, 0x00, 0x00, 0x07, 
	0xff, 0xe0, 0x00, 0x00, 0x1f, 0xff, 0xf8, 0x00, 0x00, 0x1f, 0xff, 0xfc, 0x00, 0x00, 0x3f, 0xff, 
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	0x00, 0x00, 0x00, 0x00, 0x00, 0x00, 0x00, 0x00, 0x00, 0x00, 0x00, 0x00, 0x00, 0x00, 0x00
};
// 'Гроза', 35x35px
const unsigned char thunder [175] PROGMEM = {
	0x00, 0x00, 0x00, 0x00, 0x00, 0x00, 0x00, 0x00, 0x00, 0x00, 0x00, 0x00, 0x00, 0x00, 0x00, 0x00, 
	0x00, 0x00, 0x00, 0x00, 0x00, 0x00, 0x00, 0x00, 0x00, 0x00, 0x00, 0x3e, 0x00, 0x00, 0x00, 0x03, 
	0xff, 0xc0, 0x00, 0x00, 0x07, 0xff, 0xe0, 0x00, 0x00, 0x0f, 0xff, 0xf8, 0x00, 0x00, 0x1f, 0xff, 
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	0x00, 0x10, 0x00, 0x00, 0x00, 0x00, 0x00, 0x00, 0x00, 0x00, 0x00, 0x00, 0x00, 0x00, 0x00
};
// 'Восход', 35x35px
const unsigned char bitmapSunrise [175] PROGMEM = {
	0x00, 0x00, 0x00, 0x00, 0x00, 0x00, 0x00, 0x00, 0x00, 0x00, 0x00, 0x00, 0x00, 0x00, 0x00, 0x00, 
	0x00, 0x00, 0x00, 0x00, 0x00, 0x00, 0xe0, 0x00, 0x00, 0x00, 0x01, 0xf0, 0x00, 0x00, 0x00, 0x03, 
	0xf8, 0x00, 0x00, 0x00, 0x07, 0xfc, 0x00, 0x00, 0x00, 0x07, 0xfc, 0x00, 0x00, 0x00, 0x0f, 0xfc, 
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	0x00, 0x00, 0x00, 0x00, 0x00, 0x00, 0x00, 0x00, 0x00, 0x00, 0x00, 0x00, 0x00, 0x00, 0x00
};
// 'Закат', 35x35px
const unsigned char bitmapSunset [175] PROGMEM = {
	0x00, 0x00, 0x00, 0x00, 0x00, 0x00, 0x00, 0x00, 0x00, 0x00, 0x00, 0x00, 0x00, 0x00, 0x00, 0x00, 
	0x00, 0x00, 0x00, 0x00, 0x00, 0x00, 0xe0, 0x00, 0x00, 0x00, 0x00, 0xe0, 0x00, 0x00, 0x00, 0x00, 
	0xe0, 0x00, 0x00, 0x00, 0x00, 0xe0, 0x00, 0x00, 0x00, 0x00, 0xe0, 0x00, 0x00, 0x00, 0x00, 0xe0, 
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	0x00, 0x00, 0x00, 0x00, 0x00, 0x00, 0x00, 0x00, 0x00, 0x00, 0x00, 0x00, 0x00, 0x00, 0x00
};

String itsMain="";
String desc="";
float temp=0;
uint16_t pres=0;
uint8_t humidity=0;
float wind=0;
int tempF=0;

int tempMin1=100;
int tempMin2=100;
int tempMin3=100;
int tempMin4=100;
int tempMax1=0;
int tempMax2=0;
int tempMax3=0;
int tempMax4=0;
int humidity1=0;
int humidity2=0;
int humidity3=0;
int humidity4=0;
int cnt=0;
String date1="";
String date="";
String country="";

String main2 = "";
String main3 = "";
String main4 = "";
int temp2 = 0;
int temp3 = 0;
int temp4 = 0;
int timeSunrise = 0;
int timeSunset = 0;
uint8_t sunriseH = 0;
uint8_t sunriseM = 0;
uint8_t sunsetH = 0;
uint8_t sunsetM = 0;

int getD=-1;
int getH=-1;
int getM=-1;
int getS=-1;
String fDate="";
String dayName="";
WiFiClient wifiClient;

void connectWifi() {
  WiFi.begin(WIFI_SSID, WIFI_PASSWORD);
  Serial.print("Connecting to ");
  Serial.println(WIFI_SSID);
  while (WiFi.status() != WL_CONNECTED) {
    delay(500);
    Serial.print(".");
  }
  Serial.println("");
  Serial.println("WiFi connected!");
  Serial.println(WiFi.localIP());
  Serial.println();
}

void initScreen() {
  tft.begin();
  tft.setRotation(0); // Установка вертикальной ориентации экрана
  tft.fillScreen(TFT_BLACK); // Заливка фона черным цветом
}

void setup() {
  Serial.begin(9600);
  delay(500);
  connectWifi();
  timeClient.begin();
  getTime();
  getForecastData();
  initScreen();
}

void loop() {
  getTime();
  // drawTime();
  drawDate();
  getCurrentData();
  drawScreen1();
  delay(10000);
  getForecastData();
  drawScreen2();
  delay(10000);
  timeForSunriseAndSunset();
  drawScreen3();
  delay(10000);
}

void getTime() {
  timeClient.update();
  getD=timeClient.getDay();
  getH=timeClient.getHours();
  getM=timeClient.getMinutes();
  getS=timeClient.getSeconds();
  fDate=timeClient.getFormattedTime();
  dayName=daysOfTheWeek[getD];
  Serial.print(getD);
  Serial.print(dayName);
  Serial.print(", ");
  Serial.print(getH);
  Serial.print(":");
  Serial.print(getM);
  Serial.print(":");
  Serial.println(getS);
  Serial.println(timeClient.getFormattedTime());
}

void getCurrentData() {
  OpenWeatherMapCurrentData data;
  client.setLanguage(OPEN_WEATHER_MAP_LANGUAGE);
  client.setMetric(IS_METRIC);
  client.updateCurrent(&data, OPEN_WEATHER_MAP_APP_ID, OPEN_WEATHER_MAP_LOCATION);

  itsMain=data.main.c_str();
  desc=data.description.c_str();
  temp=data.temp;
  tempF=(int)(temp);
  pres=data.pressure;
  humidity=data.humidity;
  wind=data.windSpeed;
  Serial.println("main: "+ itsMain);
  Serial.println("description: "+ desc);
  Serial.printf("temp: %f\n", temp);
  Serial.printf("pressure: %d\n", pres);
  Serial.printf("humidity: %d\n", humidity);
  Serial.printf("windSpeed: %f\n", wind);
}

void getForecastData() {
  String serverPath = "http://api.openweathermap.org/data/2.5/forecast?q=" + OPEN_WEATHER_MAP_LOCATION + "&appid=" + OPEN_WEATHER_MAP_APP_ID + "&units=metric&lang=" + OPEN_WEATHER_MAP_LANGUAGE;
  String json = httpGETRequest(serverPath.c_str());

  //updateForecastData(json);
  tempMin1=100;
  tempMin2=100;
  tempMin3=100;
  tempMin4=100;
  tempMax1=0;
  tempMax2=0;
  tempMax3=0;
  tempMax4=0;
  humidity1=0;
  humidity2=0;
  humidity3=0;
  humidity4=0;
  int t=-1;
  t=json.indexOf("dt");
  json=json.substring(t+3,json.length());
  t=-1;
  t=json.indexOf("country");
  country=json.substring(t+10,t+12);
  t=-1;
  t = json.indexOf("sunrise");
  int tSunEnd = json.indexOf("sunset");
  timeSunrise = json.substring(t + 9, tSunEnd - 2).toInt();
  timeSunset = json.substring(tSunEnd + 8, tSunEnd + 18).toInt();
  t = -1;
  date1="";
  t=json.indexOf("dt_txt");
  date1=json.substring(t+9,t+19);

  if (cnt==0) {
    date=date1;
    cnt++;
  }

  int tc=json.substring(t+20,t+22).toInt();
  t=-1;
  tc=(((tc*(-1))+21)/3)+1;

  for (int i=0;i<tc;i++) {
    t=json.indexOf("dt_txt");
    String s=json.substring(0,t+31);
    json=json.substring(t+31,json.length());
    t=-1;
    t=s.indexOf("temp_min");
    int temp=s.substring(t+10,t+13).toInt();
    Serial.println(temp);
    if (tempMin1>temp) tempMin1=temp;
    t=-1;
    t=s.indexOf("temp_max");
    temp=s.substring(t+10,t+13).toInt();
    if (tempMax1<temp) tempMax1=temp;
    t=-1;
    t=s.indexOf("humidity");
    temp=s.substring(t+10,t+12).toInt();
    humidity1=humidity1+temp;
    t=-1;
  }
  humidity1=humidity1/tc;
    
  for(int i=0;i<8;i++) {
    t=json.indexOf("dt_txt");
    String s=json.substring(0,t+31);
    json=json.substring(t+31,json.length());
    t=-1;
    t=s.indexOf("temp_min");
    int temp=s.substring(t+10,t+13).toInt();
    if(tempMin2>temp) tempMin2=temp;
    t=-1;
    t=s.indexOf("temp_max");
    temp=s.substring(t+10,t+13).toInt();
    if(tempMax2<temp) tempMax2=temp;
    t=-1;
    t=s.indexOf("humidity");
    temp=s.substring(t+10,t+12).toInt();
    humidity2=humidity2+temp;
    t=-1;
    t = s.indexOf("main", 30);
    int tEnd = s.indexOf("description");
    main2 = s.substring(t + 7, tEnd - 3);
    t = -1;
    t = s.indexOf("temp");
    temp2 = s.substring(t + 6, t + 9).toInt();
    t = -1;
  }
  humidity2=humidity2/8;
      
  for(int i=0;i<8;i++) {
    t=json.indexOf("dt_txt");
    String s=json.substring(0,t+31);
    json=json.substring(t+31,json.length());
    t=-1;
    t=s.indexOf("temp_min");
    int temp=s.substring(t+10,t+13).toInt();
    if(tempMin3>temp)
    tempMin3=temp;
    t=-1;
    t=s.indexOf("temp_max");
    temp=s.substring(t+10,t+13).toInt();
    if(tempMax3<temp)
    tempMax3=temp;
    t=-1;
    t=s.indexOf("humidity");
    temp=s.substring(t+10,t+12).toInt();
    humidity3=humidity3+temp;
    t=-1;
    t = s.indexOf("main", 30);
    int tEnd = s.indexOf("description");
    main3 = s.substring(t + 7, tEnd - 3);
    t = -1;
    t = s.indexOf("temp");
    temp3 = s.substring(t + 6, t + 9).toInt();
    t = -1;
  }
  humidity3=humidity3/8;

  for(int i=0;i<8;i++) {
    t=json.indexOf("dt_txt");
    String s=json.substring(0,t+31);
    json=json.substring(t+31,json.length());
    t=-1;
    t=s.indexOf("temp_min");
    int temp=s.substring(t+10,t+13).toInt();
    if(tempMin4>temp) tempMin4=temp;
    t=-1;
    t=s.indexOf("temp_max");
    temp=s.substring(t+10,t+13).toInt();
    if(tempMax4<temp)
    tempMax4=temp;
    t=-1;
    t=s.indexOf("humidity");
    temp=s.substring(t+10,t+12).toInt();
    humidity4=humidity4+temp;
    t=-1;
    t = s.indexOf("main", 30);
    int tEnd = s.indexOf("description");
    main4 = s.substring(t + 7, tEnd - 3);
    t = -1;
    t = s.indexOf("temp");
    temp4 = s.substring(t + 6, t + 9).toInt();
    t = -1;
  }
  humidity4=humidity4/8;
    
  json="";
  Serial.println(date1);
  Serial.println();
  Serial.print("Today ");Serial.print("Sunrise - ");Serial.print(timeSunrise);Serial.print(" Sunset - ");Serial.print(timeSunset);Serial.print(" Min Temp - ");Serial.print(tempMin1);Serial.println(" Max Temp - ");Serial.print(tempMax1);Serial.println(" Humidity - ");Serial.println(humidity1);
  Serial.print("Tomorrow ");Serial.print("Temp - ");Serial.print(temp2);Serial.print(" main2 - ");Serial.print(main2);Serial.print(" Min Temp - ");Serial.print(tempMin2);Serial.print(" Max Temp - ");Serial.print(tempMax2);Serial.print(" Humidity - ");Serial.println(humidity2);
  Serial.print("Day After Tomorrow ");Serial.print("Temp - ");Serial.print(temp2);Serial.print(" main3 - ");Serial.print(main3);Serial.print(" Min Temp - ");Serial.print(tempMin3);Serial.print(" Max Temp - ");Serial.print(tempMax3);Serial.print(" Humidity - ");Serial.println(humidity3);
  Serial.print("Today + 3 ");Serial.print("Temp - ");Serial.print(temp2);Serial.print(" main4 - ");Serial.print(main4);Serial.print(" Min Temp - ");Serial.print(tempMin4);Serial.print(" Max Temp - ");Serial.print(tempMax4);Serial.print(" Humidity - ");Serial.println(humidity4);
}


String httpGETRequest(const char* serverName) {
  HTTPClient http; 
  http.begin(wifiClient, serverName);
  
  int httpResponseCode = http.GET();
  
  String payload = "{}"; 
  
  if (httpResponseCode>0) {
    Serial.print("HTTP Response code: ");
    Serial.println(httpResponseCode);
    payload = http.getString();
  }
  else {
    Serial.print("Error code: ");
    Serial.println(httpResponseCode);
  }
  http.end();

  return payload;
}

void drawTime() {
  if (oM != getM) {
    oM = getM;
    int xpos = 10;
    int ypos = 35; // Top left corner ot clock text, about half way down
    tft.loadFont(Golos_Text_Regular84);
    tft.fillRect(0, 34, 240, 75, TFT_BLACK);
    tft.setCursor(xpos, ypos);
    if (getH < 10) { 
      tft.print(0);
      xpos = tft.getCursorX();
    }
    tft.print(getH);
    xpos = tft.getCursorX();
    tft.setCursor(xpos, 35 - 8);
    tft.print(":");
    xpos = tft.getCursorX();
    tft.setCursor(xpos, 35);
    if (getM < 10) {
      tft.print(0);
      xpos = tft.getCursorX();
    }
    tft.print(getM);
    tft.unloadFont();
  }
}

void drawDate() {
  //2025-01-14
  //0123456789
  int year = date.substring(0, 4).toInt();
  int monthNum = date.substring(5, 7).toInt();
  int day = date.substring(8).toInt();
  tft.loadFont(Golos_Text_Regular22);
  tft.setTextColor(TFT_WHITE);
  tft.setCursor(12, 110);
  tft.print(dayName);
  tft.print(", ");
  tft.print(day);
  tft.print(" ");
  tft.print(monthsNames[monthNum]);
  tft.print(", ");
  tft.print(year);
  tft.unloadFont();
}

void drawScreen1() {
  drawTime();
  tft.fillRect(0, 160, 240, 160, TFT_BLACK);

  drawWeatherbitmap(itsMain, 5, 220);
  tft.setCursor(47, 220);
  tft.loadFont(Golos_Text_Regular44);
  tft.setTextColor(TFT_WHITE);
  tft.print(tempF);
  tft.print("°");

  tft.setCursor(140, 220);
  tft.print(humidity);
  tft.unloadFont();

  tft.loadFont(Golos_Text_Regular30);
  tft.print("%");
  tft.unloadFont();

  tft.loadFont(Golos_Text_Regular22);
  tft.setCursor(10, 260);
  findWeatherNum(itsMain);
  tft.print(weatherNames[weatherNum]);

  tft.setCursor(120, 260);
  tft.print("влажность");
  tft.unloadFont();
}

void drawScreen2() {
  drawTime();
  tft.fillRect(0, 160, 240, 160, TFT_BLACK);

  forecastDayName_screen2();
  tft.loadFont(Golos_Text_Regular22);
  tft.setCursor(30, 180);
  tft.print(dayName2);

  tft.setCursor(110, 180);
  tft.print(dayName3);

  tft.setCursor(190, 180);
  tft.print(dayName4);
  tft.unloadFont();

  drawWeatherbitmap(main2, 20, 207);
  drawWeatherbitmap(main3, 100, 207);
  drawWeatherbitmap(main4, 180, 207);

  tft.loadFont(Golos_Text_Regular30);
  tft.setCursor(15, 252);
  tft.print(temp2);
  tft.print("°");

  tft.setCursor(95, 252);
  tft.print(temp3);
  tft.print("°");

  tft.setCursor(175, 252);
  tft.print(temp4);
  tft.print("°");
  tft.unloadFont();

  tft.loadFont(Golos_Text_Regular12);
  tft.setCursor(15, 290);
  findWeatherNum(main2);
  tft.print(weatherNames[weatherNum]);
  // tft.print("дождливо");

  tft.setCursor(95, 290);
  findWeatherNum(main3);
  tft.print(weatherNames[weatherNum]);
  // tft.print("дождливо");

  tft.setCursor(175, 290);
  findWeatherNum(main4);
  tft.print(weatherNames[weatherNum]);
  // tft.print("дождливо");
  tft.unloadFont();
}

void drawScreen3() {
  drawTime();
  tft.fillRect(0, 160, 240, 160, TFT_BLACK);

  tft.drawBitmap(15, 190, bitmapSunrise, 35, 35, TFT_WHITE);
  tft.drawBitmap(130, 190, bitmapSunset, 35, 35, TFT_WHITE);

  tft.setCursor(15, 230);
  tft.loadFont(Golos_Text_Regular22);
  tft.print("восход");

  tft.setCursor(130, 230);
  tft.print("закат");
  tft.unloadFont();

  tft.loadFont(Golos_Text_Regular44);
  tft.setCursor(15, 260);
  tft.print(sunriseH);
  tft.print(":");
  tft.print(sunriseM);

  tft.setCursor(130, 260);
  tft.print(sunsetH);
  tft.print(":");
  tft.print(sunsetM);
  tft.unloadFont();
}

void forecastDayName_screen2() {
  if (getD == 6) {
    dayName2 = daysOfTheWeek[0];
    dayName3 = daysOfTheWeek[1];
    dayName4 = daysOfTheWeek[2];
  }
  else if (getD == 5) {
    dayName2 = daysOfTheWeek[6];
    dayName3 = daysOfTheWeek[0];
    dayName4 = daysOfTheWeek[1];
  }
  else if (getD == 4) {
    dayName2 = daysOfTheWeek[5];
    dayName3 = daysOfTheWeek[6];
    dayName4 = daysOfTheWeek[0];
  }
  else {
    dayName2 = daysOfTheWeek[getD + 1];
    dayName3 = daysOfTheWeek[getD + 2];
    dayName4 = daysOfTheWeek[getD + 3];
  }
}

void drawWeatherbitmap(String mainCur, int xpos, int ypos) {
  if(mainCur.equals("Clouds")) {
    tft.drawBitmap(xpos, ypos, clouds, 35, 35, TFT_WHITE);
  }

  else if(mainCur.equals("Rain")) {
    tft.drawBitmap(xpos, ypos, rain, 35, 35, TFT_WHITE);
  }

  else if(mainCur.equals("Thunderstorm")) {
    tft.drawBitmap(xpos, ypos, thunder, 35, 35, TFT_WHITE);
  }

  else if(mainCur.equals("Clear")) {
    tft.drawBitmap(xpos, ypos, clearS1, 35, 35, TFT_WHITE);
  }

  else if(mainCur.equals("Drizzle")) {
    tft.drawBitmap(xpos, ypos, drizzle, 35, 35, TFT_WHITE);
  }

  else if(mainCur.equals("Snow")) {
    tft.drawBitmap(xpos, ypos, snow, 35, 35, TFT_WHITE);
  }

  else {
    tft.drawBitmap(xpos, ypos, mist, 35, 35, TFT_WHITE);
  }
}

void findWeatherNum(String main) {
  if(main.equals("Clouds")) {
    weatherNum = 0;
  }

  else if(main.equals("Rain")) {
    weatherNum = 1;
  }

  else if(main.equals("Thunderstorm")) {
    weatherNum = 2;
  }

  else if(main.equals("Clear")) {
    weatherNum = 3;
  }

  else if(main.equals("Drizzle")) {
    weatherNum = 4;
  }

  else if(main.equals("Snow")) {
    weatherNum = 5;
  }

  else {
    weatherNum = 6;
  }
}

void timeForSunriseAndSunset() {
  UnixTime stamp(utcOffsetInSeconds / 3600);
  stamp.getDateTime(timeSunrise);
  sunriseH = stamp.hour;
  sunriseM = stamp.minute;
  stamp.getDateTime(timeSunset);
  sunsetH = stamp.hour;
  sunsetM = stamp.minute;
}